## jppianta_defconfig
```kconfig
# System
BR2_SYSTEM_DHCP=""
BR2_TARGET_GENERIC_GETTY_PORT="ttyS0"

# Kernel
BR2_LINUX_KERNEL=y
BR2_LINUX_KERNEL_USE_CUSTOM_CONFIG=y
BR2_LINUX_KERNEL_CUSTOM_CONFIG_FILE="board/jppianta/jppianta_linux.config"
```
